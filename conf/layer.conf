## conf/layer.conf
```bitbake
# We have a conf and classes directory, add to BBPATH
BBPATH .= ":${LAYERDIR}"

# We have recipes-* directories, add to BBFILES
BBFILES += "${LAYERDIR}/recipes-*/*/*.bb \
	${LAYERDIR}/recipes-*/*/*.bbappend"

BBFILE_COLLECTIONS += "flutter-fbdev"
BBFILE_PATTERN_flutter-fbdev = "^${LAYERDIR}/"
BBFILE_PRIORITY_flutter-fbdev = "6"
```
